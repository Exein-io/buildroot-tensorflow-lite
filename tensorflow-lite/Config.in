## tensorflow-lite/Config.in
```kconfig
config BR2_PACKAGE_TENSORFLOW_LITE
	bool "TensorFlow Lite"
	select BR2_PACKAGE_HOST_CMAKE
	help
          TensorFlow Lite is the official solution for running
          machine learning models on mobile and embedded devices.
          It enables on-device machine learning inference with
          low latency and a small binary size on Android, iOS,
          and other operating systems.

	  https://www.tensorflow.org/lite/




comment "TensorFlow Lite needs a toolchain w/ C++"
	depends on !BR2_INSTALL_LIBSTDCPP
```
